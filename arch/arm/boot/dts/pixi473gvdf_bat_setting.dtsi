/*************************
 * Customized Battery Setting dtsi file
*************************/
&bat_comm {
	/* cust_charging.h */

	/* Charging Current Setting */
	usb_charger_current = <50000 >;	/* Unit: 0.01 mA */
	ac_charger_current = <145000 >;	/* Unit: 0.01 mA */
	non_std_ac_charger_current = <50000 >;	/* Unit: 0.01 mA */
	charging_host_charger_current = <65000 >;	/* Unit: 0.01 mA */

	/* charger error check */
	bat_low_temp_protect_enable = <0 >;
	v_charger_enable = <0 >;	/* 1:on , 0:off */
	v_charger_max = <6500 >;	/* unit: mV */
	v_charger_min = <4400 >;

	/*  Tracking TIME */
	onehundred_percent_tracking_time = <10 >;	/* Unit: second */
	npercent_tracking_time = <20 >;	/* Unit: second */
	sync_to_real_tracking_time = <60 >;	/* Unit: second */
	v_0percent_tracking = <3400 >;	/* Unit: mV */

	/* High battery support */
	high_battery_voltage_support = <0 >;

	/* cust_battery_meter.h */
	/* ADC resistor  */
	r_bat_sense = <4 >;
	r_i_sense = <4 >;
	r_charger_1 = <330 >;
	r_charger_2 = <39 >;
	temperature_t0 = <110 >;
	temperature_t1 = <0 >;
	temperature_t2 = <25 >;
	temperature_t3 = <50 >;
	temperature_t = <255 >;	/* this should be fixed, never change the value */
	fg_meter_resistance = <0 >;
};

&bat_meter {
	/* Qmax for 0mA */
	q_max_pos_50 = <3002 >;
	q_max_pos_25 = <3002 >;
	q_max_pos_0 = <3002 >;
	q_max_neg_10 = <3002 >;
	/* Qmax for 400mA, said high current */
	q_max_pos_50_h_current = <2969 >;
	q_max_pos_25_h_current = <2969 >;
	q_max_pos_0_h_current = <2969 >;
	q_max_neg_10_h_current = <2969 >;
	/* Discharge percentage, 1: D5, 0: D2 */
	oam_d5 = <1 >;

	change_tracking_point = <1 >;
	/* SW OCV tracking setting */
	cust_tracking_point = <1 >;
	cust_r_sense = <200 >;
	cust_hw_cc = <0 >;
	aging_tuning_value = <103 >;
	cust_r_fg_offset = <0 >;
	ocv_board_compesate = <0 >;
	r_fg_board_base = <1000 >;
	r_fg_board_slope = <1000 >;
	car_tune_value = <100 >;

	/* HW Fuel gague  */
	current_detect_r_fg = <10 >;	/* Unit: mA */
	minerroroffset = <1000 >;
	fg_vbat_average_size = <18 >;
	r_fg_value = <10 >;	/* Unit: mOhm */

	cust_poweron_delta_capacity_tolrance = <40 >;
	cust_poweron_low_capacity_tolrance = <5 >;
	cust_poweron_max_vbat_tolrance = <90 >;
	cust_poweron_delta_vbat_tolrance = <30 >;
	cust_poweron_delta_hw_sw_ocv_capacity_tolrance = <10 >;

	/* Fixed battery temperature */
	fixed_tbat_25 = <0 >;
	/* Dynamic change wake up period of battery thread when suspend */
	vbat_normal_wakeup = <3600 >;	/* Unit: mV */
	vbat_low_power_wakeup = <3500 >;	/* Unit: mV */
	normal_wakeup_period = <5400 >;	/* Unit: second */
	low_power_wakeup_period = <300 >;	/* Unit: second */
	close_poweroff_wakeup_period = <30 >;	/* Unit: second */

	rbat_pull_up_r = <16900 >;
	rbat_pull_up_d = <27000 >;
	rbat_pull_up_volt = <1800 >;

	batt_temperature_table_num = <17 >;
	batt_temperature_table = <
			    (-20) 68237
			    (-15) 53650
			    (-10) 42506
			    (-5) 33892
			    0 27219
			    5 22021
			    10 17926
			    15 14674
			    20 12081
			    25 10000 30 8315 35 6948 40 5834 45 4917 50 4161 55 3535 60 3014 >;

	battery_profile_t0_num = <58 >;
	battery_profile_t0 = <0 4163
				2 4140
				4 4120
				5 4103
				7 4087
				9 4073
				11 4059
				13 4041
				14 4023
				16 4007
				18 3995
				20 3984
				22 3974
				23 3963
				25 3952
				27 3941
				29 3929
				30 3919
				32 3909
				34 3898
				36 3888
				38 3877
				39 3865
				41 3850
				43 3837
				45 3828
				47 3820
				48 3813
				50 3808
				52 3802
				54 3797
				56 3793
				57 3789
				59 3785
				61 3782
				63 3779
				65 3777
				66 3775
				68 3773
				70 3770
				72 3767
				74 3763
				75 3757
				77 3751
				79 3745
				81 3739
				82 3731
				84 3721
				86 3714
				88 3701
				90 3692
				91 3690
				93 3686
				95 3679
				97 3632
				99 3533
				100 3357
				101 3318 >;

	battery_profile_t1_num = <58 >;
	battery_profile_t1 = <0 4163
				2 4140
				4 4120
				5 4103
				7 4087
				9 4073
				11 4059
				13 4041
				14 4023
				16 4007
				18 3995
				20 3984
				22 3974
				23 3963
				25 3952
				27 3941
				29 3929
				30 3919
				32 3909
				34 3898
				36 3888
				38 3877
				39 3865
				41 3850
				43 3837
				45 3828
				47 3820
				48 3813
				50 3808
				52 3802
				54 3797
				56 3793
				57 3789
				59 3785
				61 3782
				63 3779
				65 3777
				66 3775
				68 3773
				70 3770
				72 3767
				74 3763
				75 3757
				77 3751
				79 3745
				81 3739
				82 3731
				84 3721
				86 3714
				88 3701
				90 3692
				91 3690
				93 3686
				95 3679
				97 3632
				99 3533
				100 3357
				101 3318 >;

	battery_profile_t2_num = <58 >;
	battery_profile_t2 = <0 4163
				2 4140
				4 4120
				5 4103
				7 4087
				9 4073
				11 4059
				13 4041
				14 4023
				16 4007
				18 3995
				20 3984
				22 3974
				23 3963
				25 3952
				27 3941
				29 3929
				30 3919
				32 3909
				34 3898
				36 3888
				38 3877
				39 3865
				41 3850
				43 3837
				45 3828
				47 3820
				48 3813
				50 3808
				52 3802
				54 3797
				56 3793
				57 3789
				59 3785
				61 3782
				63 3779
				65 3777
				66 3775
				68 3773
				70 3770
				72 3767
				74 3763
				75 3757
				77 3751
				79 3745
				81 3739
				82 3731
				84 3721
				86 3714
				88 3701
				90 3692
				91 3690
				93 3686
				95 3679
				97 3632
				99 3533
				100 3357
				101 3318 >;

	battery_profile_t3_num = <58 >;
	battery_profile_t3 = <0 4163
				2 4140
				4 4120
				5 4103
				7 4087
				9 4073
				11 4059
				13 4041
				14 4023
				16 4007
				18 3995
				20 3984
				22 3974
				23 3963
				25 3952
				27 3941
				29 3929
				30 3919
				32 3909
				34 3898
				36 3888
				38 3877
				39 3865
				41 3850
				43 3837
				45 3828
				47 3820
				48 3813
				50 3808
				52 3802
				54 3797
				56 3793
				57 3789
				59 3785
				61 3782
				63 3779
				65 3777
				66 3775
				68 3773
				70 3770
				72 3767
				74 3763
				75 3757
				77 3751
				79 3745
				81 3739
				82 3731
				84 3721
				86 3714
				88 3701
				90 3692
				91 3690
				93 3686
				95 3679
				97 3632
				99 3533
				100 3357
				101 3318 >;

	r_profile_t0_num = <58 >;
	r_profile_t0 = <140 4166
				140 4140
				142 4120
				143 4103
				147 4087
				148 4073
				150 4059
				152 4041
				157 4023
				158 4007
				162 3995
				162 3984
				170 3974
				170 3963
				173 3952
				177 3941
				175 3929
				178 3919
				178 3909
				177 3898
				177 3888
				172 3877
				168 3865
				157 3850
				148 3837
				147 3828
				145 3820
				145 3813
				147 3808
				147 3802
				147 3797
				148 3793
				148 3789
				147 3785
				147 3782
				148 3779
				148 3777
				148 3775
				148 3773
				148 3770
				148 3767
				147 3763
				143 3757
				142 3751
				142 3745
				142 3739
				142 3731
				142 3721
				147 3714
				147 3701
				147 3692
				153 3690
				162 3686
				177 3679
				168 3632
				175 3533
				213 3357
				197 3318 >;

	r_profile_t1_num = <58 >;
	r_profile_t1 = <140 4166
				140 4140
				142 4120
				143 4103
				147 4087
				148 4073
				150 4059
				152 4041
				157 4023
				158 4007
				162 3995
				162 3984
				170 3974
				170 3963
				173 3952
				177 3941
				175 3929
				178 3919
				178 3909
				177 3898
				177 3888
				172 3877
				168 3865
				157 3850
				148 3837
				147 3828
				145 3820
				145 3813
				147 3808
				147 3802
				147 3797
				148 3793
				148 3789
				147 3785
				147 3782
				148 3779
				148 3777
				148 3775
				148 3773
				148 3770
				148 3767
				147 3763
				143 3757
				142 3751
				142 3745
				142 3739
				142 3731
				142 3721
				147 3714
				147 3701
				147 3692
				153 3690
				162 3686
				177 3679
				168 3632
				175 3533
				213 3357
				197 3318 >;

	r_profile_t2_num = <58 >;
	r_profile_t2 = <140 4166
				140 4140
				142 4120
				143 4103
				147 4087
				148 4073
				150 4059
				152 4041
				157 4023
				158 4007
				162 3995
				162 3984
				170 3974
				170 3963
				173 3952
				177 3941
				175 3929
				178 3919
				178 3909
				177 3898
				177 3888
				172 3877
				168 3865
				157 3850
				148 3837
				147 3828
				145 3820
				145 3813
				147 3808
				147 3802
				147 3797
				148 3793
				148 3789
				147 3785
				147 3782
				148 3779
				148 3777
				148 3775
				148 3773
				148 3770
				148 3767
				147 3763
				143 3757
				142 3751
				142 3745
				142 3739
				142 3731
				142 3721
				147 3714
				147 3701
				147 3692
				153 3690
				162 3686
				177 3679
				168 3632
				175 3533
				213 3357
				197 3318 >;

	r_profile_t3_num = <58 >;
	r_profile_t3 = <140 4166
				140 4140
				142 4120
				143 4103
				147 4087
				148 4073
				150 4059
				152 4041
				157 4023
				158 4007
				162 3995
				162 3984
				170 3974
				170 3963
				173 3952
				177 3941
				175 3929
				178 3919
				178 3909
				177 3898
				177 3888
				172 3877
				168 3865
				157 3850
				148 3837
				147 3828
				145 3820
				145 3813
				147 3808
				147 3802
				147 3797
				148 3793
				148 3789
				147 3785
				147 3782
				148 3779
				148 3777
				148 3775
				148 3773
				148 3770
				148 3767
				147 3763
				143 3757
				142 3751
				142 3745
				142 3739
				142 3731
				142 3721
				147 3714
				147 3701
				147 3692
				153 3690
				162 3686
				177 3679
				168 3632
				175 3533
				213 3357
				197 3318 >;
};
