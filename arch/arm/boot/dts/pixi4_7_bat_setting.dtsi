/*************************
 * Customized Battery Setting dtsi file
*************************/
&bat_comm {
	/* cust_charging.h */

	/* Charging Current Setting */
	usb_charger_current = <50000 >;	/* Unit: 0.01 mA */
	ac_charger_current = <100000 >;	/* Unit: 0.01 mA */
	non_std_ac_charger_current = <50000 >;	/* Unit: 0.01 mA */
	charging_host_charger_current = <65000 >;	/* Unit: 0.01 mA */
	
	/* charger error check */
	bat_low_temp_protect_enable = <1>;
	v_charger_enable = <0 >;	/* 1:on , 0:off */
	v_charger_max = <6500 >;	/* unit: mV */
	v_charger_min = <4400 >;

	/*  Tracking TIME */
	onehundred_percent_tracking_time = <10 >;	/* Unit: second */
	npercent_tracking_time = <20 >;	/* Unit: second */
	sync_to_real_tracking_time = <60 >;	/* Unit: second */
	v_0percent_tracking = <3400 >;	/* Unit: mV */

	/* High battery support */
	high_battery_voltage_support = <1 >;

	/* cust_battery_meter.h */
	/* ADC resistor  */
	r_bat_sense = <4 >;
	r_i_sense = <4 >;
	r_charger_1 = <330 >;
	r_charger_2 = <39 >;
	temperature_t0 = <110 >;
	temperature_t1 = <0 >;
	temperature_t2 = <25 >;
	temperature_t3 = <50 >;
	temperature_t = <255 >;	/* this should be fixed, never change the value */
	fg_meter_resistance = <0 >;
};

&bat_meter {
	/* Qmax for 0mA */
	q_max_pos_50 = <2450 >;
	q_max_pos_25 = <2450 >;
	q_max_pos_0 = <2450 >;
	q_max_neg_10 = <2450 >;
	/* Qmax for 400mA, said high current */
	q_max_pos_50_h_current = <2400 >;
	q_max_pos_25_h_current = <2400 >;
	q_max_pos_0_h_current = <1681>;
	q_max_neg_10_h_current = <1350>;
	/* Discharge percentage, 1: D5, 0: D2 */
	oam_d5 = <0 >;

	change_tracking_point = <1 >;
	/* SW OCV tracking setting */
	cust_tracking_point = <1 >;
	cust_r_sense = <200 >;
	cust_hw_cc = <0 >;
	aging_tuning_value = <103 >;
	cust_r_fg_offset = <0 >;
	ocv_board_compesate = <0 >;
	r_fg_board_base = <1000 >;
	r_fg_board_slope = <1000 >;
	car_tune_value = <100 >;

	/* HW Fuel gague  */
	current_detect_r_fg = <10 >;	/* Unit: mA */
	minerroroffset = <1000 >;
	fg_vbat_average_size = <18 >;
	r_fg_value = <10 >;	/* Unit: mOhm */

	cust_poweron_delta_capacity_tolrance = <40 >;
	cust_poweron_low_capacity_tolrance = <5 >;
	cust_poweron_max_vbat_tolrance = <90 >;
	cust_poweron_delta_vbat_tolrance = <30 >;
	cust_poweron_delta_hw_sw_ocv_capacity_tolrance = <10 >;

	/* Fixed battery temperature */
	fixed_tbat_25 = <0 >;
	/* Dynamic change wake up period of battery thread when suspend */
	vbat_normal_wakeup = <3600 >;	/* Unit: mV */
	vbat_low_power_wakeup = <3500 >;	/* Unit: mV */
	normal_wakeup_period = <5400 >;	/* Unit: second */
	low_power_wakeup_period = <300 >;	/* Unit: second */
	close_poweroff_wakeup_period = <30 >;	/* Unit: second */

	rbat_pull_up_r = <16900 >;
	rbat_pull_up_d = <27000 >;
	rbat_pull_up_volt = <1800 >;

	batt_temperature_table_num = <17 >;
	batt_temperature_table = <
			    (-20) 78108
			    (-15) 59866
			    (-10) 49271
			    (-5) 36532
			    0 28220
			    5 23267
			    10 18925
			    15 14700
			    20 12090
			    25 10000
			    30 8309
			    35 6939 
			    40 5823 
			    45 4911 
			    50 4188 
			    55 3562 
			    60 3005 >;

	/*id0 for JN battery*/
	battery_profile_id0_t0_num = <70 >;
	battery_profile_id0_t0 = <
				0   4318 
				2   4297 
				3   4278 
				5   4260 
				6   4243 
				8   4225 
				9   4209 
				11  4192 
				13  4175 
				14  4159 
				16  4143 
				17  4127 
				19  4111 
				20  4096 
				22  4081 
				24  4070 
				25  4055 
				27  4038 
				28  4020 
				30  4006 
				31  3992 
				33  3981 
				35  3970 
				36  3959 
				38  3947 
				39  3935 
				41  3920 
				43  3903 
				44  3887 
				46  3873 
				47  3862 
				49  3852 
				50  3844 
				52  3837 
				54  3830 
				55  3823 
				57  3817 
				58  3811 
				60  3805 
				61  3800 
				63  3795 
				65  3790 
				66  3786 
				68  3782 
				69  3779 
				71  3775 
				72  3771 
				74  3767 
				76  3762 
				77  3756 
				79  3748 
				80  3741 
				82  3732 
				84  3718 
				85  3707 
				87  3693 
				88  3688 
				90  3686 
				91  3684 
				93  3683 
				95  3677 
				96  3647 
				98  3578 
				99  3474 
				100 3372 
				101 3337 
				101 3320 
				101 3313 
				101 3308 
				101 3305 
				 >;

	battery_profile_id0_t1_num = <70 >;
	battery_profile_id0_t1 = <
				0   4318 
				2   4297 
				3   4278 
				5   4260 
				6   4243 
				8   4225 
				9   4209 
				11  4192 
				13  4175 
				14  4159 
				16  4143 
				17  4127 
				19  4111 
				20  4096 
				22  4081 
				24  4070 
				25  4055 
				27  4038 
				28  4020 
				30  4006 
				31  3992 
				33  3981 
				35  3970 
				36  3959 
				38  3947 
				39  3935 
				41  3920 
				43  3903 
				44  3887 
				46  3873 
				47  3862 
				49  3852 
				50  3844 
				52  3837 
				54  3830 
				55  3823 
				57  3817 
				58  3811 
				60  3805 
				61  3800 
				63  3795 
				65  3790 
				66  3786 
				68  3782 
				69  3779 
				71  3775 
				72  3771 
				74  3767 
				76  3762 
				77  3756 
				79  3748 
				80  3741 
				82  3732 
				84  3718 
				85  3707 
				87  3693 
				88  3688 
				90  3686 
				91  3684 
				93  3683 
				95  3677 
				96  3647 
				98  3578 
				99  3474 
				100 3372 
				101 3337 
				101 3320 
				101 3313 
				101 3308 
				101 3305 
				>;

	battery_profile_id0_t2_num = <70 >;
	battery_profile_id0_t2 = <
				0   4318 
				2   4297 
				3   4278 
				5   4260 
				6   4243 
				8   4225 
				9   4209 
				11  4192 
				13  4175 
				14  4159 
				16  4143 
				17  4127 
				19  4111 
				20  4096 
				22  4081 
				24  4070 
				25  4055 
				27  4038 
				28  4020 
				30  4006 
				31  3992 
				33  3981 
				35  3970 
				36  3959 
				38  3947 
				39  3935 
				41  3920 
				43  3903 
				44  3887 
				46  3873 
				47  3862 
				49  3852 
				50  3844 
				52  3837 
				54  3830 
				55  3823 
				57  3817 
				58  3811 
				60  3805 
				61  3800 
				63  3795 
				65  3790 
				66  3786 
				68  3782 
				69  3779 
				71  3775 
				72  3771 
				74  3767 
				76  3762 
				77  3756 
				79  3748 
				80  3741 
				82  3732 
				84  3718 
				85  3707 
				87  3693 
				88  3688 
				90  3686 
				91  3684 
				93  3683 
				95  3677 
				96  3647 
				98  3578 
				99  3474 
				100 3372 
				101 3337 
				101 3320 
				101 3313 
				101 3308 
				101 3305 
				 >;

	battery_profile_id0_t3_num = <70 >;
	battery_profile_id0_t3 = <
				0   4318 
				2   4297 
				3   4278 
				5   4260 
				6   4243 
				8   4225 
				9   4209 
				11  4192 
				13  4175 
				14  4159 
				16  4143 
				17  4127 
				19  4111 
				20  4096 
				22  4081 
				24  4070 
				25  4055 
				27  4038 
				28  4020 
				30  4006 
				31  3992 
				33  3981 
				35  3970 
				36  3959 
				38  3947 
				39  3935 
				41  3920 
				43  3903 
				44  3887 
				46  3873 
				47  3862 
				49  3852 
				50  3844 
				52  3837 
				54  3830 
				55  3823 
				57  3817 
				58  3811 
				60  3805 
				61  3800 
				63  3795 
				65  3790 
				66  3786 
				68  3782 
				69  3779 
				71  3775 
				72  3771 
				74  3767 
				76  3762 
				77  3756 
				79  3748 
				80  3741 
				82  3732 
				84  3718 
				85  3707 
				87  3693 
				88  3688 
				90  3686 
				91  3684 
				93  3683 
				95  3677 
				96  3647 
				98  3578 
				99  3474 
				100 3372 
				101 3337 
				101 3320 
				101 3313 
				101 3308 
				101 3305 
				>;

	r_profile_id0_t0_num = <70 >;
	r_profile_id0_t0 = <
				192       4318 
				192       4297 
				193       4278 
				197       4260 
				200       4243 
				198       4225 
				203       4209 
				205       4192 
				205       4175 
				210       4159 
				212       4143 
				215       4127 
				217       4111 
				220       4096 
				220       4081 
				227       4070 
				230       4055 
				233       4038 
				230       4020 
				232       4006 
				232       3992 
				232       3981 
				232       3970 
				232       3959 
				235       3947 
				235       3935 
				230       3920 
				220       3903 
				213       3887 
				208       3873 
				207       3862 
				205       3852 
				207       3844 
				208       3837 
				208       3830 
				210       3823 
				207       3817 
				203       3811 
				200       3805 
				198       3800 
				200       3795 
				200       3790 
				200       3786 
				202       3782 
				202       3779 
				202       3775 
				200       3771 
				200       3767 
				198       3762 
				198       3756 
				197       3748 
				200       3741 
				202       3732 
				195       3718 
				200       3707 
				205       3693 
				210       3688 
				220       3686 
				240       3684 
				260       3683 
				280       3677 
				280       3647 
				278       3578 
				302       3474 
				290       3372 
				230       3337 
				203       3320 
				188       3313 
				182       3308 
				177       3305 
				175       3303 
				172       3302 
				170       3300 
				170       3298 
				168       3298 
				165       3297 
				163       3296 
				>;

	r_profile_id0_t1_num = <70 >;
	r_profile_id0_t1 = <
				192       4318 
				192       4297 
				193       4278 
				197       4260 
				200       4243 
				198       4225 
				203       4209 
				205       4192 
				205       4175 
				210       4159 
				212       4143 
				215       4127 
				217       4111 
				220       4096 
				220       4081 
				227       4070 
				230       4055 
				233       4038 
				230       4020 
				232       4006 
				232       3992 
				232       3981 
				232       3970 
				232       3959 
				235       3947 
				235       3935 
				230       3920 
				220       3903 
				213       3887 
				208       3873 
				207       3862 
				205       3852 
				207       3844 
				208       3837 
				208       3830 
				210       3823 
				207       3817 
				203       3811 
				200       3805 
				198       3800 
				200       3795 
				200       3790 
				200       3786 
				202       3782 
				202       3779 
				202       3775 
				200       3771 
				200       3767 
				198       3762 
				198       3756 
				197       3748 
				200       3741 
				202       3732 
				195       3718 
				200       3707 
				205       3693 
				210       3688 
				220       3686 
				240       3684 
				260       3683 
				280       3677 
				280       3647 
				278       3578 
				302       3474 
				290       3372 
				230       3337 
				203       3320 
				188       3313 
				182       3308 
				177       3305 
				175       3303 
				172       3302 
				170       3300 
				170       3298 
				168       3298 
				165       3297 
				163       3296 
				>;

	r_profile_id0_t2_num = <70 >;
	r_profile_id0_t2 = <
				192       4318 
				192       4297 
				193       4278 
				197       4260 
				200       4243 
				198       4225 
				203       4209 
				205       4192 
				205       4175 
				210       4159 
				212       4143 
				215       4127 
				217       4111 
				220       4096 
				220       4081 
				227       4070 
				230       4055 
				233       4038 
				230       4020 
				232       4006 
				232       3992 
				232       3981 
				232       3970 
				232       3959 
				235       3947 
				235       3935 
				230       3920 
				220       3903 
				213       3887 
				208       3873 
				207       3862 
				205       3852 
				207       3844 
				208       3837 
				208       3830 
				210       3823 
				207       3817 
				203       3811 
				200       3805 
				198       3800 
				200       3795 
				200       3790 
				200       3786 
				202       3782 
				202       3779 
				202       3775 
				200       3771 
				200       3767 
				198       3762 
				198       3756 
				197       3748 
				200       3741 
				202       3732 
				195       3718 
				200       3707 
				205       3693 
				210       3688 
				220       3686 
				240       3684 
				260       3683 
				280       3677 
				280       3647 
				278       3578 
				302       3474 
				290       3372 
				230       3337 
				203       3320 
				188       3313 
				182       3308 
				177       3305 
				175       3303 
				172       3302 
				170       3300 
				170       3298 
				168       3298 
				165       3297 
				163       3296 
				>;

	r_profile_id0_t3_num = <70 >;
	r_profile_id0_t3 = <
				192       4318 
				192       4297 
				193       4278 
				197       4260 
				200       4243 
				198       4225 
				203       4209 
				205       4192 
				205       4175 
				210       4159 
				212       4143 
				215       4127 
				217       4111 
				220       4096 
				220       4081 
				227       4070 
				230       4055 
				233       4038 
				230       4020 
				232       4006 
				232       3992 
				232       3981 
				232       3970 
				232       3959 
				235       3947 
				235       3935 
				230       3920 
				220       3903 
				213       3887 
				208       3873 
				207       3862 
				205       3852 
				207       3844 
				208       3837 
				208       3830 
				210       3823 
				207       3817 
				203       3811 
				200       3805 
				198       3800 
				200       3795 
				200       3790 
				200       3786 
				202       3782 
				202       3779 
				202       3775 
				200       3771 
				200       3767 
				198       3762 
				198       3756 
				197       3748 
				200       3741 
				202       3732 
				195       3718 
				200       3707 
				205       3693 
				210       3688 
				220       3686 
				240       3684 
				260       3683 
				280       3677 
				280       3647 
				278       3578 
				302       3474 
				290       3372 
				230       3337 
				203       3320 
				188       3313 
				182       3308 
				177       3305 
				175       3303 
				172       3302 
				170       3300 
				170       3298 
				168       3298 
				165       3297 
				163       3296 
				>;

	/*id1 for SCUD battery*/
	battery_profile_id1_t0_num = <66>;
	battery_profile_id1_t0 = <	
		/*modify time   20160314*/
				0     4287
				2     4239
				4     4218
				5     4208
				7     4182
				8     4171
				9     4161
				11    4138
				12    4130
				14    4117
				16    4097
				18    4081
				20    4059
				21    4050
				23    4032
				24    4020
				25    4007
				27    3986
				28    3980
				30    3968
				32    3950
				33    3941
				34    3932
				36    3912
				37    3906
				39    3894
				41    3877
				43    3863
				45    3850
				46    3847
				48    3840
				50    3830
				52    3821
				53    3818
				55    3813
				57    3805
				59    3798
				61    3792
				62    3790
				64    3787
				66    3783
				68    3780
				70    3776
				71    3774
				73    3771
				75    3765
				77    3757
				79    3746
				80    3741
				82    3732
				84    3717
				86    3705
				87    3702
				89    3698
				90    3693
				91    3691
				92    3689
				93    3687
				94    3685
				95    3682
				96    3669
				97    3648
				98    3604
				99    3566
				100   3504
				101   3441
				>;

	battery_profile_id1_t1_num = <66>;
	battery_profile_id1_t1 = <
		/*modify time   20160314*/
				0     4287
				2     4239
				4     4218
				5     4208
				7     4182
				8     4171
				9     4161
				11    4138
				12    4130
				14    4117
				16    4097
				18    4081
				20    4059
				21    4050
				23    4032
				24    4020
				25    4007
				27    3986
				28    3980
				30    3968
				32    3950
				33    3941
				34    3932
				36    3912
				37    3906
				39    3894
				41    3877
				43    3863
				45    3850
				46    3847
				48    3840
				50    3830
				52    3821
				53    3818
				55    3813
				57    3805
				59    3798
				61    3792
				62    3790
				64    3787
				66    3783
				68    3780
				70    3776
				71    3774
				73    3771
				75    3765
				77    3757
				79    3746
				80    3741
				82    3732
				84    3717
				86    3705
				87    3702
				89    3698
				90    3693
				91    3691
				92    3689
				93    3687
				94    3685
				95    3682
				96    3669
				97    3648
				98    3604
				99    3566
				100   3504
				101   3441
				 >;

	battery_profile_id1_t2_num = <66>;
	battery_profile_id1_t2 = <
	//modify time   	20160224
				0		4318	
				2		4297	
				3		4278	
				5		4260	
				6		4243	
				8		4225	
				9		4209	
				11		4192	
				13		4175	
				14		4159	
				16		4143	
				17		4127	
				19		4111	
				20		4096	
				22		4081	
				24		4070	
				25		4055	
				27		4038	
				28		4020	
				30		4006	
				31		3992	
				33		3981	
				35		3970	
				36		3959	
				38		3947	
				39		3935	
				41		3920	
				43		3903	
				44		3887	
				46		3873	
				47		3862	
				49		3852	
				50		3844	
				52		3837	
				54		3830	
				55		3823	
				57		3817	
				58		3811	
				60		3805	
				61		3800	
				63		3795	
				65		3790	
				66		3786	
				68		3782	
				69		3779	
				71		3775	
				72		3771	
				74		3767	
				76		3762	
				77		3756	
				79		3748	
				80		3741	
				82		3732	
				84		3718	
				85		3707	
				87		3693	
				88		3688	
				90		3686	
				91		3684	
				93		3683	
				95		3677	
				96		3647	
				98		3588  //3578	
				99		3548  //3474	 
				100		3500  //3372
				101		3400  //3337	
				 >;

	battery_profile_id1_t3_num = <66 >;
	battery_profile_id1_t3 = <
	//modify time   	20160224
				0		4318	 
				2		4297	 
				3		4278	 
				5		4260	 
				6		4243	 
				8		4225	 
				9		4209	 
				11		4192	 
				13		4175	 
				14		4159	 
				16		4143	 
				17		4127	 
				19		4111	 
				20		4096	 
				22		4081	 
				24		4070	 
				25		4055	 
				27		4038	 
				28		4020	 
				30		4006	 
				31		3992	 
				33		3981	 
				35		3970	 
				36		3959	 
				38		3947	 
				39		3935	 
				41		3920	 
				43		3903	 
				44		3887	 
				46		3873	 
				47		3862	 
				49		3852	 
				50		3844	 
				52		3837	 
				54		3830	 
				55		3823	 
				57		3817	 
				58		3811	 
				60		3805	 
				61		3800	 
				63		3795	 
				65		3790	 
				66		3786	 
				68		3782	 
				69		3779	 
				71		3775	 
				72		3771	 
				74		3767	 
				76		3762	 
				77		3756	 
				79		3748	 
				80		3741	 
				82		3732	 
				84		3718	 
				85		3707	 
				87		3693	 
				88		3688	 
				90		3686	 
				91		3684	 
				93		3683	 
				95		3677	 
				96		3647	 
				98		3588  //3578	
				99		3548  //3474	 
				100		3500  //3372
				101		3400  //3337	 
				>;

	r_profile_id1_t0_num = <66>;
	r_profile_id1_t0 = <
	/*modify time 20160315*/
				212     4318
				212     4297
				213     4278
				217     4260
				200     4243
				218     4225
				203     4209
				205     4192
				205     4175
				210     4159
				212     4143
				215     4127
				217     4111
				220     4096
				220     4081
				227     4070
				230     4055
				233     4038
				230     4020
				232     4006
				232     3992
				232     3981
				232     3970
				232     3959
				235     3947
				235     3935
				230     3920
				220     3903
				213     3887
				218     3873
				217     3862
				215     3852
				217     3844
				218     3837
				218     3830
				220     3823
				237     3817
				233     3811
				230     3805
				238     3800
				240     3795
				230     3790
				240     3786
				242     3782
				242     3779
				242     3775
				240     3771
				240     3767
				238     3762
				248     3756
				247     3748
				250     3741
				252     3732
				245     3718
				250     3707
				255     3693
				260     3688
				270     3686
				280     3684
				300     3683
				320     3677
				320     3647
				328     3578
				322     3474
				290     3372
				230     3337
				>;
	r_profile_id1_t1_num = <66>;
	r_profile_id1_t1 = <
	/*modify time 20160315*/
				212     4318
				212     4297
				213     4278
				217     4260
				200     4243
				218     4225
				203     4209
				205     4192
				205     4175
				210     4159
				212     4143
				215     4127
				217     4111
				220     4096
				220     4081
				227     4070
				230     4055
				233     4038
				230     4020
				232     4006
				232     3992
				232     3981
				232     3970
				232     3959
				235     3947
				235     3935
				230     3920
				220     3903
				213     3887
				218     3873
				217     3862
				215     3852
				217     3844
				218     3837
				218     3830
				220     3823
				237     3817
				233     3811
				230     3805
				238     3800
				240     3795
				230     3790
				240     3786
				242     3782
				242     3779
				242     3775
				240     3771
				240     3767
				238     3762
				248     3756
				247     3748
				250     3741
				252     3732
				245     3718
				250     3707
				255     3693
				260     3688
				270     3686
				280     3684
				300     3683
				320     3677
				320     3647
				328     3578
				322     3474
				290     3372
				230     3337
								>;        
                
	r_profile_id1_t2_num = <66>;
	r_profile_id1_t2 = <
				192		4318  
				192     4297
				193     4278
				197     4260
				200     4243
				198     4225
				203     4209
				205     4192
				205     4175
				210     4159
				212     4143
				215     4127
				217     4111
				220     4096
				220     4081
				227     4070
				230     4055
				233     4038
				230     4020
				232     4006
				232     3992
				232     3981
				232     3970
				232     3959
				235     3947
				235     3935
				230     3920
				220     3903
				213     3887
				208     3873
				207     3862
				205     3852
				207     3844
				208     3837
				208     3830
				210     3823
				207     3817
				203     3811
				200     3805
				198     3800
				200     3795
				200     3790
				200     3786
				202     3782
				202     3779
				202     3775
				200     3771
				200     3767
				198     3762
				198     3756
				197     3748
				200     3741
				202     3732
				195     3718
				200     3707
				205     3693
				210     3688
				220     3686
				240     3684
				260     3683
				280     3677
				280     3647
				278     3578
				302     3474
				290     3372
				230     3337
				>;

	r_profile_id1_t3_num = <66>;
	r_profile_id1_t3 = <
				192		4318       
				192     4297  
				193     4278  
				197     4260  
				200     4243  
				198     4225  
				203     4209  
				205     4192  
				205     4175  
				212     4159  
				210     4143  
				215     4127  
				217     4111  
				220     4096  
				220     4081  
				227     4070  
				230     4055  
				233     4038  
				230     4020  
				232     4006  
				232     3992  
				232     3981  
				232     3970  
				232     3959  
				235     3947  
				235     3935  
				230     3920  
				220     3903  
				213     3887  
				208     3873  
				207     3862  
				205     3852  
				207     3844  
				208     3837  
				208     3830  
				210     3823  
				207     3817  
				203     3811  
				200     3805  
				198     3800  
				200     3795  
				200     3790  
				200     3786  
				202     3782  
				202     3779  
				202     3775  
				200     3771  
				200     3767  
				198     3762  
				198     3756  
				197     3748  
				200     3741  
				202     3732  
				195     3718  
				200     3707  
				205     3693  
				210     3688  
				220     3686  
				240     3684  
				260     3683  
				280     3677  
				280     3647  
				278     3578  
				302     3474  
				290     3372  
				230     3337  
				>;
};
