## drivers/misc/mediatek/accelerometer/mxc4005/Kconfig
```kconfig
config MTK_MXC4005
	bool "MTK_MXC4005 for MediaTek package"
	default n
	help
	  It support different accelerometer sensor.
          If this option is set,
	  it will support
          MTK_MXC4005 Accelerometer.
```
